/dts-v1/;
/plugin/;

/ {
	metadata {
		title ="Enable Radxa DP MST MODE";
		compatible = "radxa,cm4-io";
		category = "display";
		exclusive = "dp1_in_vp2", "dsi_in_vp2";
		description = "Enable Radxa DP MST MODE.
		The MST mode only supports USB-C interfaces and requires the use of monitors compatible with MST.";
	};
};

&dp1 {
	status = "okay";
};

&dp1_in_vp2 {
	status = "okay";
};